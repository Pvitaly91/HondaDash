#include "endpoint.hpp"
#include "protocol/protocol.hpp"

#include <array>
#include <iostream>
#include <stdexcept>
#include <string>
#include <vector>

namespace {
void require(bool condition, const char* expression, int line) {
    if (!condition) throw std::runtime_error(std::string("line ") + std::to_string(line) + ": " + expression);
}
#define CHECK(expression) require(static_cast<bool>(expression), #expression, __LINE__)

using Bytes = std::vector<std::uint8_t>;
constexpr std::uint32_t Session = 0x01020304;
const Bytes HelloGolden{0xa5,0x5a,1,1,4,3,2,1,0x44,0x33,0x22,0x11,0,0x65,0xe5};
const Bytes HelloReplyGolden{
    0xa5,0x5a,1,0x81,4,3,2,1,0x44,0x33,0x22,0x11,0x12,
    1,0x73,0x79,0x6e,0x74,0x68,0x65,0x74,0x69,0x63,0x2d,0x64,0x65,0x6d,0x6f,0x2d,0x76,0x31,0x45,0x3c};
// Independent scaled words retained from M0 (not generated by either endpoint).
const Bytes KnownManual{0x29,0x09,0xa6,0x02,0x85,0xff,0x1c,0x01,0x37,0x02,0xdb,0x03,0x41,0x05};
const Bytes KnownSnapshot{
    1,0x29,0x09,1,0xa6,0x02,1,0x85,0xff,1,0x1c,0x01,1,0x37,0x02,1,0xdb,0x03,1,0x41,0x05};

void feed(hd_nano::Endpoint& endpoint, const Bytes& bytes, std::uint32_t now = 0) {
    for (const auto byte : bytes) {
        endpoint.receive(byte, now);
        CHECK(endpoint.buffered() <= hd_nano::MaxFrame);
        CHECK(endpoint.available() <= hd_nano::TxCapacity);
    }
    endpoint.tick(now);
}
Bytes drain(hd_nano::Endpoint& endpoint, std::size_t chunk = 3) {
    Bytes result;
    std::array<std::uint8_t, 79> bytes{};
    while (endpoint.available()) {
        const auto count = endpoint.read(bytes.data(), chunk);
        CHECK(count <= chunk && count != 0);
        result.insert(result.end(), bytes.begin(), bytes.begin() + static_cast<std::ptrdiff_t>(count));
    }
    return result;
}
hd::Frame exchange(hd_nano::Endpoint& endpoint, std::uint8_t type, std::uint32_t id,
                   const Bytes& payload = {}, std::uint32_t now = 0) {
    feed(endpoint, hd::encode({type, Session, id, payload}), now);
    hd::Parser parser;
    const auto frames = parser.feed(drain(endpoint));
    CHECK(frames.size() == 1);
    CHECK(frames[0].session == Session && frames[0].request == id);
    return frames[0];
}
void ack(const hd::Frame& frame, std::uint8_t type) {
    CHECK(frame.type == (type | 0x80) && frame.payload == Bytes{0});
}
void error(const hd::Frame& frame, std::uint8_t code) {
    CHECK(frame.type == 0xff && frame.payload == Bytes{code});
}

void goldenAndControl() {
    hd_nano::Endpoint endpoint;
    feed(endpoint, HelloGolden);
    CHECK(drain(endpoint, 1) == HelloReplyGolden);
    feed(endpoint, HelloGolden);
    CHECK(drain(endpoint) == HelloReplyGolden);
    CHECK(endpoint.counters().duplicates == 1);
    endpoint.reset(0);
    error(exchange(endpoint, 2, 1), 3);
    CHECK(exchange(endpoint, 1, 1).type == 0x81);
    const auto info = exchange(endpoint, 0x10, 2);
    CHECK(info.type == 0x90);
    CHECK(info.payload == (Bytes{1,2,0,2,0,15,0,'n','a','n','o','-','s','y','n','t','h','e','t','i','c'}));
    ack(exchange(endpoint, 0x11, 3, {3,1,0,0,0}), 0x11);
    ack(exchange(endpoint, 0x12, 4, KnownManual), 0x12);
    const auto sample = exchange(endpoint, 2, 5);
    CHECK(sample.type == 0x82 && sample.payload == KnownSnapshot);
    const auto decoded = hd::decodeSnapshot(sample, 123);
    CHECK(decoded && decoded->values[0] == 2345 && decoded->values[2] == -12.3);
    ack(exchange(endpoint, 0x14, 6, {1,1,1,1,3,4,1}), 0x14);
    const auto quality = exchange(endpoint, 2, 7).payload;
    CHECK(quality[12] == 3 && quality[13] == 0 && quality[14] == 0x80);
    CHECK(quality[15] == 4 && quality[16] == 0 && quality[17] == 0x80);
    error(exchange(endpoint, 0x11, 8, {4,0,0,0,0}), 2);
    error(exchange(endpoint, 0x13, 9, {0,0x89,0x13,0}), 2); // 5001 ms
    error(exchange(endpoint, 0x14, 10, {1,1,0,1,1,1,1}), 2);
    Bytes invalidManual = KnownManual;
    invalidManual[0] = 0xff; invalidManual[1] = 0x7f;
    error(exchange(endpoint, 0x12, 11, invalidManual), 2);
    CHECK(exchange(endpoint, 2, 12).payload[1] == 0x29); // atomic rejection
    error(exchange(endpoint, 0x40, 13), 1);
    error(exchange(endpoint, 2, 14, {0}), 2);
    error(exchange(endpoint, 0x10, 15, {0}), 2);
    feed(endpoint, hd::encode({2, Session + 1, 16, {}}));
    hd::Parser parser;
    const auto wrongSession = parser.feed(drain(endpoint));
    CHECK(wrongSession.size() == 1 && wrongSession[0].payload == Bytes{3});
    feed(endpoint, hd::encode({1, Session + 1, 1000, {0}}));
    const auto malformedHello = parser.feed(drain(endpoint));
    CHECK(malformedHello.size() == 1 && malformedHello[0].payload == Bytes{2});
    CHECK(exchange(endpoint, 2, 16).type == 0x82); // identity/order still intact
    endpoint.reset(500);
    error(exchange(endpoint, 2, 17), 3);
    CHECK(exchange(endpoint, 1, 18).type == 0x81);
    CHECK(exchange(endpoint, 2, 19).type == 0x82);
}

void framingAndBounds() {
    static_assert(sizeof(hd_nano::Endpoint) <= 768, "Keep endpoint static memory bounded");
    hd_nano::Endpoint endpoint;
    CHECK(exchange(endpoint, 1, 1).type == 0x81);
    const auto maximum = hd::encode({0x7e, Session, 2, Bytes(64, 0x44)});
    CHECK(maximum.size() == 79);
    feed(endpoint, maximum);
    hd::Parser parser;
    auto frames = parser.feed(drain(endpoint));
    CHECK(frames.size() == 1); error(frames[0], 1);
    Bytes corrupt = hd::encode({2, Session, 3, {}}); corrupt.back() ^= 0x80;
    feed(endpoint, {0, 0xaa, 0xa5, 0, 0x5a});
    feed(endpoint, corrupt);
    CHECK(endpoint.available() == 0);
    auto version = hd::encode({2, Session, 3, {}}); version[2] = 2;
    feed(endpoint, version);
    auto length = hd::encode({2, Session, 3, {}}); length[12] = 65;
    feed(endpoint, length);
    CHECK(endpoint.available() == 0);
    Bytes truncated = maximum; truncated.resize(20);
    feed(endpoint, truncated);
    CHECK(exchange(endpoint, 2, 3).type == 0x82);
    CHECK(endpoint.counters().parserErrors >= 4);
    const auto one = hd::encode({2, Session, 4, {}});
    const auto two = hd::encode({2, Session, 5, {}});
    Bytes joined = one; joined.insert(joined.end(), two.begin(), two.end());
    feed(endpoint, joined);
    frames = parser.feed(drain(endpoint, 1));
    CHECK(frames.size() == 2 && frames[0].request == 4 && frames[1].request == 5);
    // Faulty peer sends continuously without reading: fixed ring fails visibly.
    for (std::uint32_t id = 6; id < 300; ++id) feed(endpoint, hd::encode({2, Session, id, {}}));
    CHECK(endpoint.counters().txOverflows > 0);
    frames = parser.feed(drain(endpoint));
    CHECK(!frames.empty());
    CHECK(frames.back().type == 0xff);
    CHECK(exchange(endpoint, 1, 300).type == 0x81);
    CHECK(exchange(endpoint, 2, 301).type == 0x82);
    // Deterministic adversarial bytes exercise all fixed storage with canaries.
    struct Guarded { std::array<std::uint8_t,32> before; hd_nano::Endpoint endpoint;
                     std::array<std::uint8_t,32> after; } guarded{};
    guarded.before.fill(0x5c); guarded.after.fill(0xc5);
    std::uint32_t random = 1;
    for (std::uint32_t n = 0; n < 100000; ++n) {
        random = random * 1664525U + 1013904223U;
        guarded.endpoint.receive(static_cast<std::uint8_t>(random >> 24), n);
        CHECK(guarded.endpoint.buffered() <= 79 && guarded.endpoint.available() <= 158);
    }
    for (const auto byte : guarded.before) CHECK(byte == 0x5c);
    for (const auto byte : guarded.after) CHECK(byte == 0xc5);
}

void faultsAndDuplicates() {
    hd_nano::Endpoint endpoint;
    CHECK(exchange(endpoint, 1, 1).type == 0x81);
    ack(exchange(endpoint, 0x13, 2, {1,0,0,1}), 0x13);
    feed(endpoint, hd::encode({2, Session, 3, {}}));
    CHECK(drain(endpoint).empty());
    ack(exchange(endpoint, 0x13, 4, {0,0,0,1}), 0x13);
    const auto read = hd::encode({2, Session, 5, {}});
    feed(endpoint, read);
    const auto corrupt = drain(endpoint);
    CHECK(corrupt.size() == 36);
    hd::Parser parser;
    CHECK(parser.feed(corrupt).empty());
    feed(endpoint, read);
    CHECK(drain(endpoint) == corrupt); // exact duplicate replays bytes, not side effect
    CHECK(exchange(endpoint, 2, 6).type == 0x82);
    error(exchange(endpoint, 2, 5), 5);
    error(exchange(endpoint, 0x10, 6), 5); // same ID, different operation
    ack(exchange(endpoint, 0x13, 7, {0,0,0,2}), 0x13);
    const auto control = hd::encode({0x13, Session, 7, {0,0,0,2}});
    feed(endpoint, control);
    const auto duplicateAck = parser.feed(drain(endpoint));
    CHECK(duplicateAck.size() == 1); ack(duplicateAck[0], 0x13);
    feed(endpoint, hd::encode({2, Session, 8, {}}));
    CHECK(drain(endpoint).size() == 18);
    CHECK(exchange(endpoint, 2, 9).type == 0x82);
    // Replaying an old one-shot control cannot arm it a second time.
    feed(endpoint, control);
    const auto rejected = parser.feed(drain(endpoint));
    CHECK(rejected.size() == 1); error(rejected[0], 5);
    CHECK(exchange(endpoint, 2, 10).type == 0x82);
}

void timeAndWrap() {
    hd_nano::Endpoint endpoint;
    constexpr std::uint32_t start = 0xfffffff0U;
    endpoint.reset(start);
    CHECK(exchange(endpoint, 1, 1, {}, start).type == 0x81);
    ack(exchange(endpoint, 0x13, 2, {0,40,0,0}, start), 0x13);
    feed(endpoint, hd::encode({2, Session, 3, {}}), start);
    endpoint.tick(start + 39U); CHECK(endpoint.available() == 0);
    // Controls can restore responses while the delayed snapshot is pending.
    ack(exchange(endpoint, 0x13, 4, {0,0,0,0}, start + 39U), 0x13);
    endpoint.tick(start + 40U);
    hd::Parser parser;
    auto frames = parser.feed(drain(endpoint));
    CHECK(frames.size() == 1 && frames[0].request == 3);
    CHECK(exchange(endpoint, 2, 5, {}, start + 41U).type == 0x82);
    ack(exchange(endpoint, 0x11, 6, {2,123,0,0,0}, start), 0x11);
    hd_nano::Endpoint reference;
    CHECK(exchange(reference, 1, 1).type == 0x81);
    ack(exchange(reference, 0x11, 2, {2,123,0,0,0}), 0x11);
    CHECK(exchange(endpoint, 2, 7, {}, start + 4000U).payload == exchange(reference, 2, 3, {}, 4000).payload);
    ack(exchange(endpoint, 0x13, 8, {0,100,0,0}, 10), 0x13);
    feed(endpoint, hd::encode({2, Session, 9, {}}), 10);
    feed(endpoint, hd::encode({2, Session, 9, {}}), 99);
    CHECK(endpoint.available() == 0);
    endpoint.tick(110);
    frames = parser.feed(drain(endpoint));
    CHECK(frames.size() == 1 && frames[0].request == 9);
    // New session cancels delayed old output; no stale firmware payload leaks.
    feed(endpoint, hd::encode({2, Session, 10, {}}), 120);
    feed(endpoint, hd::encode({1, Session + 1, 1, {}}), 121);
    CHECK(!drain(endpoint).empty());
    endpoint.tick(1000); CHECK(endpoint.available() == 0);
}

void scenariosAndStress() {
    hd_nano::Endpoint endpoint;
    CHECK(exchange(endpoint, 1, 1).type == 0x81);
    ack(exchange(endpoint, 0x11, 2, {0,1,0,0,0}), 0x11);
    CHECK(exchange(endpoint, 2, 3).payload == (Bytes{
        1,0,0,1,0,0,1,220,0,1,220,0,1,0,0,1,0xe8,3,1,0xe2,4}));
    ack(exchange(endpoint, 0x11, 4, {1,1,0,0,0}), 0x11);
    const auto idle = hd::decodeSnapshot(exchange(endpoint, 2, 5), 0);
    CHECK(idle && *idle->values[0] >= 836 && *idle->values[0] <= 864 && *idle->values[6] == 14.2);
    ack(exchange(endpoint, 0x11, 6, {2,77,0,0,0}), 0x11);
    std::uint32_t id = 7;
    for (std::uint32_t now = 0; now <= 3600000U; now += 100U) {
        const auto sample = hd::decodeSnapshot(exchange(endpoint, 2, id++, {}, now), now);
        CHECK(sample);
        for (const auto quality : sample->qualities) CHECK(quality == hd::Quality::Valid);
        CHECK(endpoint.buffered() == 0 && endpoint.available() == 0);
    }
    for (std::uint32_t cycle = 0; cycle < 500; ++cycle) {
        endpoint.reset(cycle * 10);
        error(exchange(endpoint, 2, 1), 3);
        CHECK(exchange(endpoint, 1, 1).type == 0x81);
        CHECK(exchange(endpoint, 2, 2).type == 0x82);
    }
}
}

int main() {
    try {
        goldenAndControl(); framingAndBounds(); faultsAndDuplicates(); timeAndWrap(); scenariosAndStress();
        std::cout << "embedded endpoint: golden/control/framing/faults/wrap/stress PASS; sizeof="
                  << sizeof(hd_nano::Endpoint) << " host bytes\n";
        return 0;
    } catch (const std::exception& error) { std::cerr << error.what() << '\n'; return 1; }
}
